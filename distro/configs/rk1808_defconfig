## distro/configs/rk1808_defconfig
```kconfig
#include "audio.config"
#include "base.install"
#include "base.config"
#include "camera.config"
#include "debug.install"
#include "gst_audio.config"
#include "gst_camera.config"
#include "gst_video.config"
#include "qtapp.config"
#include "video.config"
#include "wifi.config"
BR2_PACKAGE_RKWIFIBT_AP6212A1=y
BR2_PACKAGE_RKWIFIBT_BTUART="ttyS4"
```

## distro/configs/rk3288_defconfig
```kconfig
#include "audio.config"
#include "base.install"
#include "base.config"
#include "camera.config"
#include "debug.install"
#include "gpu.config"
#include "graphics.config"
#include "gst_audio.config"
#include "gst_camera.config"
#include "gst_video.config"
#include "qtapp.config"
#include "video.config"
#include "wifi.config"
BR2_PACKAGE_RKWIFIBT_AMPAKALL=y
BR2_PACKAGE_RKWIFIBT_BTUART="ttyS0"
```

## distro/package/Config.in
```kconfig
menu "Target packages"
	source "package/QLauncher/Config.in"
	source "package/alsa-config/Config.in"
	source "package/busybox/Config.in"
	source "package/camera_engine_rkisp/Config.in"
	source "package/deviceio_release/Config.in"
	source "package/ffmpeg/Config.in"
	source "package/glmark2/Config.in"
	source "package/gstreamer/Config.in"
	source "package/gst-plugins-bad/Config.in"
	source "package/gst-plugins-base/Config.in"
	source "package/gst-plugins-good/Config.in"
	source "package/gst-plugins-ugly/Config.in"
	source "package/gstreamer-rockchip/Config.in"
        source "package/libdrm/Config.in"
        source "package/libmad/Config.in"
        source "package/libmali/Config.in"
        source "package/libmpg123/Config.in"
        source "package/libwpa_client/Config.in"
	source "package/mpp/Config.in"
	source "package/multicamera/Config.in"
	source "package/multivideoplayer/Config.in"
	source "package/rkscript/Config.in"
	source "package/rktoolkit/Config.in"
	source "package/rkwifibt/Config.in"
	source "package/qcamera/Config.in"
	source "package/qplayer/Config.in"
	source "package/qfm/Config.in"
	source "package/qsetting/Config.in"
	source "package/weston/Config.in"
endmenu
```

## distro/package/libwpa_client/Config.in
```kconfig
config BR2_PACKAGE_LIBWPA_CLIENT
	bool "libwpa_client"
	help
	  "libwpa_client built from wpa_supplicant"
```

## distro/package/multivideoplayer/Config.in
```kconfig
config BR2_PACKAGE_MULTIVIDEOPLAYER
	bool "multivideo player app"
	depends on BR2_PACKAGE_GSTREAMER_ROCKCHIP
	help
	  "multivideo player app based on QT5"
```

## distro/package/qcamera/Config.in
```kconfig
config BR2_PACKAGE_QCAMERA
	bool "camera app"
	select BR2_PACKAGE_GST_PLUGINS_BAD_CAMERABIN2
	select BR2_PACKAGE_GST_PLUGINS_BASE_APP
	select BR2_PACKAGE_GST_PLUGINS_BASE_AUDIORATE
	select BR2_PACKAGE_GST_PLUGINS_BASE_ENCODING
	select BR2_PACKAGE_GST_PLUGINS_BASE_VOLUME
	select BR2_PACKAGE_GST_PLUGINS_GOOD_GST_V4L2
	select BR2_PACKAGE_GST_PLUGINS_GOOD_MULTIFILE
	select BR2_PACKAGE_GST_PLUGINS_GOOD_VIDEOCROP
	help
	  "camera app based on QT5"
```

## distro/package/qsetting/Config.in
```kconfig
config BR2_PACKAGE_QSETTING
	bool "qsetting app"
	help
	  "setting app based on QT5"
```

## u-boot/configs/x3399_defconfig
```kconfig
CONFIG_SYS_EXTRA_OPTIONS="RKCHIP_RK3399,PRODUCT_MID,NORMAL_WORLD,SECOND_LEVEL_BOOTLOADER,BAUDRATE=115200"
CONFIG_ARM=y
CONFIG_ROCKCHIP_ARCH64=y
CONFIG_PLAT_RK33XX=y
```
